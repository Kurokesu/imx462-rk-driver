// SPDX-License-Identifier: GPL-2.0-only
// Copyright (c) 2026, UAB Kurokesu. All rights reserved.

#define IMX462_CAM		2
#define IMX462_I2C		i2c3
#define IMX462_XCLR_PIN		RK_PD1
#define IMX462_PHY		csi2_dphy2
#define IMX462_CSI2		mipi3_csi2
#define IMX462_CIF		rkcif_mipi_lvds3
#define IMX462_CIF_SDITF	rkcif_mipi_lvds3_sditf
#define IMX462_ISP		rkisp0_vir1
#define IMX462_INDEX		1

#include "imx462.dtsi"
