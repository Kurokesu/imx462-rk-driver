// SPDX-License-Identifier: GPL-2.0-only
// Copyright (c) 2026, UAB Kurokesu. All rights reserved.

#define IMX462_CAM		3
#define IMX462_I2C		i2c5
#define IMX462_XCLR_PIN		RK_PD2
#define IMX462_PHY		csi2_dcphy1
#define IMX462_CSI2		mipi1_csi2
#define IMX462_CIF		rkcif_mipi_lvds1
#define IMX462_CIF_SDITF	rkcif_mipi_lvds1_sditf
#define IMX462_ISP		rkisp1_vir1
#define IMX462_INDEX		2

#include "imx462.dtsi"
